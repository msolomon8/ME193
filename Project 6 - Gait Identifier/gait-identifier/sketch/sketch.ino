// Gait Identifier - UNO Q MCU side.
// Samples an MPU-6050 (accelerometer + gyro) at 50 Hz into a ring buffer.
// Python on the Linux side collects new samples with Bridge.call("imu") and
// shows model 2's answer as an animated stick figure with Bridge.call("show", activity, frame_ms).
#include <Arduino_RouterBridge.h>
#include <Arduino_LED_Matrix.h>
#include <Wire.h>

// ---- IMU ----
const uint32_t SAMPLE_MS = 20;   // 50 Hz
const int RING = 200;            // 4 s of samples, plenty if Python is slow for a moment
const int MAX_PER_CALL = 50;

TwoWire *bus = nullptr;          // whichever bus the MPU-6050 answered on
uint8_t addr = 0;
int16_t ring[RING][6];           // ax ay az gx gy gz, raw counts
uint32_t head = 0;               // total samples taken (sequence number of the next one)
uint32_t tail = 0;               // sequence number of the next sample to hand to Python
uint32_t nextSample = 0;

void writeReg(uint8_t reg, uint8_t val) {
  bus->beginTransmission(addr);
  bus->write(reg);
  bus->write(val);
  bus->endTransmission();
}

bool findImu() {
  TwoWire *buses[] = {&Wire1, &Wire};   // Qwiic connector first, then the A4/A5 header
  uint8_t addrs[] = {0x68, 0x69};
  for (TwoWire *b : buses) {
    b->begin();
    b->setClock(400000);
    for (uint8_t a : addrs) {
      b->beginTransmission(a);
      if (b->endTransmission() == 0) {
        bus = b;
        addr = a;
        return true;
      }
    }
  }
  return false;
}

void setupImu() {
  writeReg(0x6B, 0x00);   // wake up
  delay(50);
  writeReg(0x1A, 0x03);   // low-pass filter ~44 Hz
  writeReg(0x1B, 0x18);   // gyro +-2000 deg/s (16.4 counts per deg/s)
  writeReg(0x1C, 0x18);   // accel +-16 g (2048 counts per g); running ankles can pass 8 g
}

bool readImu(int16_t out[6]) {
  bus->beginTransmission(addr);
  bus->write(0x3B);
  if (bus->endTransmission(false) != 0) return false;
  if (bus->requestFrom(addr, (uint8_t)14) != 14) return false;
  uint8_t b[14];
  for (int i = 0; i < 14; i++) b[i] = bus->read();
  out[0] = (b[0] << 8) | b[1];
  out[1] = (b[2] << 8) | b[3];
  out[2] = (b[4] << 8) | b[5];
  // b[6..7] is temperature
  out[3] = (b[8] << 8) | b[9];
  out[4] = (b[10] << 8) | b[11];
  out[5] = (b[12] << 8) | b[13];
  return true;
}

// "seq;ax,ay,az,gx,gy,gz;ax,..."  (seq = sequence number of the first sample)
// "NOIMU" if the sensor was not found.
String imu() {
  if (!bus) return String("NOIMU");
  if (head - tail > RING) tail = head - RING;   // Python fell behind: oldest samples are gone
  String s = String(tail);
  int n = 0;
  while (tail < head && n < MAX_PER_CALL) {
    int16_t *r = ring[tail % RING];
    s += ';';
    for (int i = 0; i < 6; i++) {
      if (i) s += ',';
      s += r[i];
    }
    tail++;
    n++;
  }
  return s;
}

// ---- LED matrix: a stick figure standing, walking, running or biking ----
Arduino_LED_Matrix matrix;
uint8_t frame[104];              // 13 columns x 8 rows

// FRAMES BEGIN (generated by make_led_frames.py in ME193, don't edit by hand)
const int N_FRAMES[4] = {1, 4, 4, 4};   // standing, walking, running, biking
const uint8_t ANIM[4][4][104] = {
  {  // standing
    {0,0,0,0,0,0,255,255,0,0,0,0,0,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0,0},
  },
  {  // walking
    {0,0,0,0,0,0,255,255,0,0,0,0,0,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0,0},
    {0,0,0,0,0,0,255,255,0,0,0,0,0,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0,0},
    {0,0,0,0,0,0,255,255,0,0,0,0,0,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0,0},
    {0,0,0,0,0,0,255,255,0,0,0,0,0,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0,0},
  },
  {  // running
    {0,0,0,0,0,0,0,0,255,255,0,0,0,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0,0},
    {0,0,0,0,0,0,0,0,255,255,0,0,0,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0,0},
    {0,0,0,0,0,0,0,0,255,255,0,0,0,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0,0},
    {0,0,0,0,0,0,0,0,255,255,0,0,0,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0,0},
  },
  {  // biking
    {0,0,0,0,0,0,0,255,255,0,0,0,0,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70,0},
    {0,0,0,0,0,0,0,255,255,0,0,0,0,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70,0},
    {0,0,0,0,0,0,0,255,255,0,0,0,0,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70,0},
    {0,0,0,0,0,0,0,255,255,0,0,0,0,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70,0},
  },
};
// FRAMES END

// 5x7 symbols for when there is no figure to show, one byte per row, bit 4 = leftmost column
const uint8_t FONT[][7] = {
  {0x0E, 0x11, 0x01, 0x02, 0x04, 0x00, 0x04},   // ? no model yet
  {0x00, 0x00, 0x00, 0x1F, 0x00, 0x00, 0x00},   // - no IMU / waiting
};

int activity = 5;                // 0 standing, 1 walking, 2 running, 3 biking, 4 no model, 5 no IMU
uint32_t frameMs = 250;          // time per frame; 4 frames = one stride or pedal turn
int frameIdx = 0;
uint32_t lastFrame = 0;

void drawNow() {
  if (activity >= 0 && activity < 4) {
    matrix.draw((uint8_t *)ANIM[activity][frameIdx % N_FRAMES[activity]]);
    return;
  }
  memset(frame, 0, sizeof(frame));
  const uint8_t *g = FONT[activity == 4 ? 0 : 1];
  for (int r = 0; r < 7; r++)
    for (int c = 0; c < 5; c++)
      if (g[r] & (0x10 >> c)) frame[r * 13 + 4 + c] = 255;
  matrix.draw(frame);
}

// Python calls this when the activity or its pace changes.
void show(int act, int ms) {
  if (act != activity) frameIdx = 0;
  activity = act;
  frameMs = constrain(ms, 60, 2000);
  drawNow();
}

void animate() {
  uint32_t now = millis();
  if (activity < 4 && N_FRAMES[activity] > 1 && now - lastFrame >= frameMs) {
    lastFrame = now;
    frameIdx = (frameIdx + 1) % N_FRAMES[activity];
    drawNow();
  }
}

void setup() {
  matrix.begin();
  matrix.setGrayscaleBits(8);
  drawNow();

  if (findImu()) setupImu();

  Bridge.begin();
  Bridge.provide_safe("imu", imu);   // runs between loop() passes, so the ring buffer is never half-written
  Bridge.provide_safe("show", show);
}

void loop() {
  animate();
  if (!bus) return;
  uint32_t now = millis();
  if ((int32_t)(now - nextSample) < 0) return;
  nextSample = (now - nextSample > 100) ? now + SAMPLE_MS : nextSample + SAMPLE_MS;   // resync after a long stall
  if (readImu(ring[head % RING])) head++;
}
